## conf/layer.conf
```bitbake
# We have a conf and classes directory, add to BBPATH
BBPATH .= ":${LAYERDIR}"

# We have recipes-* directories, add to BBFILES
BBFILES += "${LAYERDIR}/recipes-*/*/*.bb \
            ${LAYERDIR}/recipes-*/*/*.bbappend"

BBFILE_COLLECTIONS += "macnica"
BBFILE_PATTERN_macnica = "^${LAYERDIR}/"
BBFILE_PRIORITY_macnica = "6"

LAYERDEPENDS_macnica = "core ossystems-base"
LAYERSERIES_COMPAT_macnica = "dunfell"
```

## conf/machine/rv1108-minievb.conf
```bitbake
#@TYPE: Machine
#@NAME: Rockchip RV1108 minievb-v10
#@SOC: rv1108

require conf/machine/include/tune-cortexa7.inc
require conf/machine/include/soc-family.inc

SOC_FAMILY = "rv1108"

MACHINE_FEATURES = "ext2 rtc usbgadget usbhost"

SERIAL_CONSOLES = "1500000;ttyS2"

UBOOT_MACHINE = "evb-mini-rv1108_defconfig"
PREFERRED_PROVIDER_virtual/bootloader = "u-boot-macnica"
PREFERRED_PROVIDER_u-boot = "u-boot-macnica"

UBOOT_EXTLINUX = "1"
UBOOT_EXTLINUX_ROOT = "root=/dev/mmcblk0p1"
UBOOT_EXTLINUX_CONSOLE = "console=ttyS2,${baudrate}"

PREFERRED_PROVIDER_virtual/kernel = "linux-macnica"
KERNEL_DEVICETREE = "rv1108-evb-mini.dtb"

MACHINE_EXTRA_RRECOMMENDS += "kernel-modules"
MACHINE_ESSENTIAL_EXTRA_RDEPENDS += " \
    kernel-image \
    kernel-devicetree \
    u-boot-macnica \
"

IMAGE_FSTYPES = "wic.bmap wic.gz"

WKS_FILES = "macnica.wks"
```
